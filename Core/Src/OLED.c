#include "main.h"
#include "OLED.h"
#include "i2c.h"

/*OLED字模库，宽8像素，高16像素*/
const uint8_t OLED_F8x16[][16]=
{
	0x00,0x00,0x00,0x00,0x00,0x00,0x00,0x00,
	0x00,0x00,0x00,0x00,0x00,0x00,0x00,0x00,//  0
	
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	0x00,0x00,0x00,0x00,0x00,0x00,0x00,0x00,//~ 94
};

void HAL_Write_Cmd(uint8_t cmd){
HAL_I2C_WriteByte(0x78,0x00,cmd);
}
void HAL_Write_Data(uint8_t data){
HAL_I2C_WriteByte(0x78,0x40,data);
}

void HAL_OLED_Init(void)
{
    // 1. 初始化 I2C 外设
    MX_I2C1_Init();
    HAL_I2C_MspInit(&hi2c1);
    
    HAL_Delay(100);
    
    // 2. 发送初始化命令序列
    HAL_Write_Cmd(0xAE); // 关闭显示
    
    HAL_Write_Cmd(0x00); // 设置低列地址
    HAL_Write_Cmd(0x10); // 设置高列地址
    HAL_Write_Cmd(0x40); // 设置起始行地址
    
    HAL_Write_Cmd(0x81); // 设置对比度
    HAL_Write_Cmd(0xFF); // 对比度最大值 (0-255)
    
    HAL_Write_Cmd(0xA4); // 整个显示开启 (不显示RAM内容，显示正常)
    HAL_Write_Cmd(0xA6); // 正常显示模式 (非反相)
    
    HAL_Write_Cmd(0xA8); // 占空比设置
    HAL_Write_Cmd(0x3F); // 64路 (1/64 duty)
    
    HAL_Write_Cmd(0xD3); // 显示偏移
    HAL_Write_Cmd(0x00); // 无偏移
    
    HAL_Write_Cmd(0xD5); // 振荡频率
    HAL_Write_Cmd(0x80); // 标准频率
    
    HAL_Write_Cmd(0xD9); // 预充电周期
    HAL_Write_Cmd(0xF1); 
    
    HAL_Write_Cmd(0xDA); // COM 引脚配置
    HAL_Write_Cmd(0x12); // 交替配置
    
    HAL_Write_Cmd(0xDB); // VCOMH 取消选择
    HAL_Write_Cmd(0x40); 
    
    HAL_Write_Cmd(0x8D); // 电荷泵设置
    HAL_Write_Cmd(0x14); // 开启电荷泵 (关键！不开屏幕不亮)
	
	HAL_Write_Cmd(0x20); // 设置内存寻址模式
    HAL_Write_Cmd(0x02); // 0x02 = 页寻址模式 (Page Addressing Mode)
	
	HAL_Write_Cmd(0xA1); // 设置段重映射 (左右翻转)
    HAL_Write_Cmd(0xC8); // 设置扫描方向 (上下翻转)
    
    HAL_Write_Cmd(0xAF); // 开启显示
}

void HAL_OLED_SetPos(uint8_t x,uint8_t y){
  HAL_Write_Cmd(0xb0+y);
  HAL_Write_Cmd(((x&0xf0)>>4)| 0x10);
  HAL_Write_Cmd((x&0x0f)|0x00);
}

void OLED_Clear(void){
   uint8_t i,j;
   for(i=0;i<8;i++){
   HAL_Write_Cmd(0xb0+i);
   HAL_Write_Cmd(0x00);
   HAL_Write_Cmd(0x10);
	   for(j=0;j<128;j++){
	   HAL_Write_Data(0x00);
	   
	   }
   }
}

void OLED_ShowChar(uint8_t x,uint8_t y,char Char)
{
     volatile uint8_t i;
	HAL_OLED_SetPos(x-1,y-1);
	for(int i=0;i<8;i++){
	HAL_Write_Data(OLED_F8x16[Char-' '][i]);
	}
	HAL_OLED_SetPos(x-1,y);
	for(int i=0;i<8;i++){
	HAL_Write_Data(OLED_F8x16[Char-' '][i+8]);
	}

}

uint32_t OLED_Pow(uint32_t X, uint32_t Y)
{
	uint32_t Result = 1;
	while (Y--)
	{
		Result *= X;
	}
	return Result;
}

void OLED_ShowNum(uint8_t Line, uint8_t Column, uint32_t Number, uint8_t Length)
{
	uint8_t i;
	for (i = 0; i < Length; i++)							
	{
		OLED_ShowChar(Column + i*8, Line, Number / OLED_Pow(10, Length - i - 1) % 10 + '0');
	}
}





